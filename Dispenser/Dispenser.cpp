#include "Dispenser.h"
#include <Arduino.h>

// -------------------------------------------------------
// בנאי 
// -------------------------------------------------------
Dispenser::Dispenser(int serPin) {
    servoPin = serPin;
}
//אתחול
void Dispenser::begin(){
    //  מחברים את הפין ישירות לתדר והרזולוציה
    ledcAttach(servoPin, 50, 16);
    // נעילת המנוע
    lockServo();
    // הדפסת הודעת בקרה למחשב
    Serial.println("[Dispenser] אותחל - PWM ידני 50Hz, סרוו נעול");
}

// -------------------------------------------------------
// angleToDuty - duty cycle המרה של זווית (0-180) ל- דיגיטלי
// -------------------------------------------------------
uint32_t Dispenser::angleToDuty(int angle) {
    // נוסחה מתמטית שמחשבת איפה נמצאת הזווית המבוקשת 
    // בתוך הטווח שבין פולס המינימום (3276) לפולס המקסימום (6553).
    return SERVO_MIN_DUTY + (uint32_t)angle * (SERVO_MAX_DUTY - SERVO_MIN_DUTY) / 180;
}

// -------------------------------------------------------
// setAngle - הזזת מנוע הסרוו לזווית פיזית מוגדרת
// -------------------------------------------------------
void Dispenser::setAngle(int angle) {
    // ודוא שהזווית לא חורגת מהיכולת הפיזית של המנוע
    // אם נשלחה בטעות זווית שלילית - היא תתוקן ל-0. אם נשלחה מעל 180 - היא תתוקן ל-180.
    if (angle < 0)   angle = 0;
    if (angle > 180) angle = 180;
    
    targetAngle = angle; // עדכון המשתנה הפנימי בזווית הנוכחית
    
    // שליחת האות הדיגיטלי המחושב לפין שמחובר לערוץ ה-PWM כדי שהמנוע יסתובב בפועל לזווית שנבחרה
    ledcWrite(servoPin, angleToDuty(angle));
}


// -------------------------------------------------------
// releasePill - שחרור כדור מתא ספציפי
// -------------------------------------------------------
void Dispenser::releasePill(int compartmentID) {
    // מערך המגדיר זווית ייחודית לכל אחד מ-4 תאי התרופות:
    // תא 0 יסתובב ל-45°, תא 1 ל-90°, תא 2 ל-135°, תא 3 ל-180°
    int angles[] = {45, 90, 135, 180};

    // בדיקה שמספר התא שהתקבל הוא חוקי
    if (compartmentID < 0 || compartmentID > 3) {
        Serial.println("[Dispenser] מזהה תא לא חוקי");
        return; 
    }

    // הדפסת הודעת בקרה המציגה את מספר התא והזווית אליה המנוע הולך להסתובב
    Serial.print("[Dispenser] מוציא כדור מתא ");
    Serial.print(compartmentID);
    Serial.print(" - זווית ");
    Serial.println(angles[compartmentID]);

    // הזזת המנוע לזווית המיפוי של התא שנבחר (הפתח של התא נפתח)
    setAngle(angles[compartmentID]);
    
    // השהייה למשך 0.8 שניות כדי לתת לכדור זמן ליפול פיזית מהתא
    delay(DISPENSE_MS);
    
    // סגירה ונעילה מחדש של המנגנון כדי למנוע מכדורים נוספים ליפול
    lockServo();
}

// -------------------------------------------------------
// lockServo - נעילת המנגנון והחזרתו למצב סגור (0 מעלות)
// -------------------------------------------------------
void Dispenser::lockServo() {
    setAngle(LOCKED_ANGLE); // LOCKED_ANGLE מוגדר כ-0 מעלות
    Serial.println("[Dispenser] סרוו נעול (0°)");
}
